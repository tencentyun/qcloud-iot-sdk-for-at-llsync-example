## esp32-at/components/qcloud_at/Kconfig
```kconfig
menu "QCloud IoT"
config AT_QCLOUD_IOT_COMMAND_SUPPORT

    bool "AT QCloud IoT command support."
    default "y"
    depends on AT_ENABLE

endmenu # wolfSSL
```
